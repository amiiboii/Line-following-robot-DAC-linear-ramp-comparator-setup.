const byte byteLookupTable[][2] = {
  {0, B00000000},
  {1, B00000001},
  {2, B00000010},
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  {255, B11111111}
};


// Pin definitions for DAC1 and DAC2
const int dacPins1[] = {2, 3, 4, 5, 6, 7, 8, 9};
const int dacPins2[] = {10, 11, A0, A1, A2, A3, A4, A5};
const int numPins = sizeof(dacPins1) / sizeof(dacPins1[0]);

void setup() {
  // Initialize DAC pins for DAC1 and DAC2 as outputs
  for (int i = 0; i < numPins; i++) {
    pinMode(dacPins1[i], OUTPUT);
    pinMode(dacPins2[i], OUTPUT);
  }
  Serial.begin(9600);

  pinMode(A6, INPUT_PULLUP);
  pinMode(A7, INPUT_PULLUP);

  
}


void loop() {

    // Continuously read sensor values from A6 and A7
  int sensorValueA6 = analogRead(A6);
  int sensorValueA7 = analogRead(A7);
  
//   Print sensor readings to the serial monitor
  Serial.print(sensorValueA6);
  Serial.print(",");
  Serial.println(sensorValueA7);
  delay (15);
  
  if (Serial.available() >= 4) {
    byte byte10_1 = Serial.parseInt(); // Read an integer value for DAC1
    byte byte10_2 = Serial.parseInt(); // Read an integer value for DAC2

    byte byte2_1 = 0; // Default value for DAC1
    byte byte2_2 = 0; // Default value for DAC2

    for (int i = 0; i < sizeof(byteLookupTable) / sizeof(byteLookupTable[0]); i++) {
      if (byteLookupTable[i][0] == byte10_1) {
        byte2_1 = byteLookupTable[i][1];
      }
      if (byteLookupTable[i][0] == byte10_2) {
        byte2_2 = byteLookupTable[i][1];
      }
    }

    // Set the pins high based on the byte 2 value for DAC1
    for (int i = 0; i < numPins; i++) {
      if (bitRead(byte2_1, i)) {
        digitalWrite(dacPins1[i], HIGH);
      } else {
        digitalWrite(dacPins1[i], LOW);
      }
    }

    // Set the pins high based on the byte 2 value for DAC2
    for (int i = 0; i < numPins; i++) {
      if (bitRead(byte2_2, i)) {
        digitalWrite(dacPins2[i], HIGH);
      } else {
        digitalWrite(dacPins2[i], LOW);
      }
    }
  } 



    // Provide feedback in the serial monitor
//    Serial.print("DAC1 - Byte 10: ");
//    Serial.print(byte10_1);
//    Serial.print(" | Byte 2: ");
//    Serial.println(byte2_1);
//    Serial.print("DAC2 - Byte 10: ");
//    Serial.print(byte10_2);
//    Serial.print(" | Byte 2: ");
//    Serial.println(byte2_2);

    
  
}
